## boards/shields/meka/Kconfig.defconfig
```kconfig
if SHIELD_MEKA

# Name must be less than 16 characters long!
config ZMK_KEYBOARD_NAME
    default "meka"

endif
```

## boards/shields/meka_jdm/Kconfig.defconfig
```kconfig
if SHIELD_MY_KEYBOARD

# Name must be less than 16 characters long!
config meka_jdm
    default "meka_jdm"

endif
```

## boards/shields/meka_jdm/Kconfig.shield
```kconfig
# No whitespace after the comma or in your keyboard name!
config SHIELD_MEKA_JDM
    def_bool $(shields_list_contains,meka_jdm)
```
